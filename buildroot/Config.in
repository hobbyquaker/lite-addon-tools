## buildroot/Config.in
```kconfig
source "$BR2_EXTERNAL_LITE_TOOLS_PATH/package/htop-static/Config.in"
source "$BR2_EXTERNAL_LITE_TOOLS_PATH/package/iotop-c/Config.in"
source "$BR2_EXTERNAL_LITE_TOOLS_PATH/package/ldns/Config.in"
```

## buildroot/package/htop-static/Config.in
```kconfig
config BR2_PACKAGE_HTOP_STATIC
	bool "htop (static)"
	depends on BR2_USE_MMU # fork()
	depends on BR2_STATIC_LIBS
	select BR2_PACKAGE_NCURSES
	help
	  Buildroot's htop, linked statically. Buildroot's own package
	  refuses BR2_STATIC_LIBS because of the dlopen() of optional
	  libraries (libsensors, libnl, libsystemd); htop's
	  --enable-static builds without them. Same version and the
	  same hash as package/htop.

	  https://htop.dev/
```

## buildroot/package/iotop-c/Config.in
```kconfig
config BR2_PACKAGE_IOTOP_C
	bool "iotop-c"
	depends on BR2_USE_MMU
	select BR2_PACKAGE_NCURSES
	help
	  iotop in C (no Python): per-process I/O, from the kernel's
	  taskstats (CONFIG_TASKSTATS, CONFIG_TASK_IO_ACCOUNTING,
	  CONFIG_TASK_DELAY_ACCT).

	  https://github.com/Tomas-M/iotop
```

## buildroot/package/ldns/Config.in
```kconfig
config BR2_PACKAGE_LDNS
	bool "ldns (drill)"
	depends on BR2_USE_MMU
	select BR2_PACKAGE_OPENSSL
	help
	  NLnet Labs' DNS library and its lookup tool drill, a dig
	  alternative. Buildroot's bind (dig) cannot be linked
	  statically (libuv).

	  https://www.nlnetlabs.nl/projects/ldns/
```
